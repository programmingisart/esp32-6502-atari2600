#include "6502.c"

#define takebit(value, bit) (((value) >> (7-bit)) & 0x01)

//uint8_t PROG[] = {0xa2, 0x01, 0x86, 0x00, 0x38, 0xa0, 0xE, 0x98, 0xe9, 0x03, 0xa8, 0x18, 0xa9, 0x02, 0x85, 0x01, 0xa6, 0x01, 0x65, 0x00, 0x85, 0x01, 0x86, 0x00, 0x88, 0xd0, 0xf5, 0xa4, 0x00};

//uint8_t PROG[] = {0xA9, 0x00, 0x85, 0x01, 0xA9, 0x02, 0x85, 0x00, 0x85, 0x02, 0x85, 0x02, 0x85,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 0xFF, 0xFF};

//kernel1
//uint8_t PROG[] = {0xA9, 0x00, 0x85, 0x01, 0xA9, 0x02, 0x85, 0x00, 0x85, 0x02, 0x85, 0x02, 0x85,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 0x00, 0xF0};

//kernel2,pf1
uint8_t PROG[] = {0xA2, 0x00, 0xA9, 0x00, 0x95, 0x00, 0xE8, 0xD0, 0xFB, 0xA9, 0x00, 0x85, 0x80,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 0xFF, 0xFF};

//kernel3,box
//uint8_t PROG[] = {0xA2, 0x00, 0xA9, 0x00, 0x95, 0x00, 0xE8, 0xD0, 0xFB, 0xA9, 0x45, 0x85, 0x08,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 0xFF, 0xFF};

uint8_t VRAM[192][160];
//uint8_t VRAM_h[160];

uint16_t p_X = 0;
uint16_t p_Y = 0;

uint8_t reset_tv;


uint8_t halt_cpu;
uint8_t tick_cpu;
uint8_t tiaclock = 0;

unsigned long oldtime;

void updateScreen() {
  //Serial.println(micros() - oldtime);
  //oldtime = micros();
  for (uint8_t i = 0 ; i < 192; i++) {
    for (uint8_t j = 0 ; j < 160; j++) {
      Serial.print(VRAM[i][j], HEX);
      Serial.print(",");
    }
    Serial.println();
  }
  Serial.println("NEWLINE");
}


void tia() {

  VSYNC = MEMORY[0x00];
  VBLANK = MEMORY[0x01];
  COLUPF = MEMORY[0X08];
  COLUBK = MEMORY[0x09];
  CTRLPF = MEMORY[0X0A];
  PF0 = MEMORY[0X0D];
  PF1 = MEMORY[0X0E];
  PF2 = MEMORY[0X0F];

  p_X++;
  if (p_X == 228) { //New scanline
    p_X = 0;
    p_Y++;
    if (p_Y == 262) {
      updateScreen();
      p_Y = 0;
    }
    if (halt_cpu == 1) {
      halt_cpu = 0;
      tick_cpu = 0;
    }
  }

  if (VSYNC & 0b00000010) {
    p_Y = 3;
  }

  if (WSYNC == 1) {
    WSYNC = 0;
    halt_cpu = 1;
  }


  uint8_t p_Y_dis = p_Y - 40;
  uint8_t p_X_dis = p_X - 68;

  if ((p_X >= 68) && (p_Y >= 40) && (p_Y <= 231)) {

    VRAM[p_Y_dis][p_X_dis] = COLUBK;
    if (CTRLPF & 0b00000001) { //if mirror playfield
      if ((p_X_dis >= 0 && p_X_dis <= 15) && takebit(PF0, (int)(3.9 - (p_X_dis / 4)))) VRAM[p_Y_dis][p_X_dis] = COLUPF ;
      if ((p_X_dis >= 144 && p_X_dis <= 159) && takebit(PF0, (int)(((p_X_dis / 4) - 36)))) VRAM[p_Y_dis][p_X_dis] = COLUPF ;

      if ((p_X_dis >= 16 && p_X_dis <= 47) && takebit(PF1, (int)((p_X_dis / 4) - 4))) VRAM[p_Y_dis][p_X_dis] = COLUPF ;
      if ((p_X_dis >= 112 && p_X_dis <= 143) && takebit(PF1, (int)(7.9 - ((p_X_dis / 4) - 28)))) VRAM[p_Y_dis][p_X_dis] = COLUPF;

      if ((p_X_dis >= 48 && p_X_dis <= 79) && takebit(PF2, (int)(7.9 - ((p_X_dis / 4) - 12)))) VRAM[p_Y_dis][p_X_dis] = COLUPF ;
      if ((p_X_dis >= 80 && p_X_dis <= 111) && takebit(PF2, (int)((p_X_dis / 4) - 20))) VRAM[p_Y_dis][p_X_dis] = COLUPF ;
    }
    else { //if copy playfield
      if ((p_X_dis >= 0 && p_X_dis <= 15) && takebit(PF0, (int)(3.9 - (p_X_dis / 4)))) VRAM[p_Y_dis][p_X_dis] = COLUPF ;
      if ((p_X_dis >= 80 && p_X_dis <= 95) && takebit(PF0, (int)(3.9 - ((p_X_dis / 4) - 20)))) VRAM[p_Y_dis][p_X_dis] = COLUPF ;

      if ((p_X_dis >= 16 && p_X_dis <= 47) && takebit(PF1, (int)((p_X_dis / 4) - 4))) VRAM[p_Y_dis][p_X_dis] = COLUPF ;
      if ((p_X_dis >= 96 && p_X_dis <= 127) && takebit(PF1, (int)((p_X_dis / 4) - 24))) VRAM[p_Y_dis][p_X_dis] = COLUPF;

      if ((p_X_dis >= 48 && p_X_dis <= 90) && takebit(PF2, (int)((p_X_dis / 4) - 12))) VRAM[p_Y_dis][p_X_dis] = COLUPF ;
      if ((p_X_dis >= 128 && p_X_dis <= 159) && takebit(PF2, (int)((p_X_dis / 4) - 32))) VRAM[p_Y_dis][p_X_dis] = COLUPF ;
    }
    //Serial.print(p_Y);
    //Serial.print(" ");
    //Serial.println(p_X);
  }
}
void setup() {

  Serial.begin(921600);
  Serial.println();
  Serial.println(getCpuFrequencyMhz());

  for (int i = 0 ; i < 8192; i++) {
    MEMORY[i] = 0;
  }
  //Serial.println("Loalding Program...");
  for (int i = 0; i < (sizeof(PROG) / sizeof(PROG[0])); i++) {
    MEMORY[4096 + i] = PROG [i];
    //Serial.print(PROG[i], HEX);
  }

  PC = 4096;
  //Serial.print("Program Loaded, PC initialied to ");
  Serial.println(PC);
  halt_cpu = 0;
  tick_cpu = 0;
  tiaclock = 2;
  Serial.println("NEWLINE");

}

void loop() {
  tiaclock++;
  if (tiaclock == 2) {
    tiaclock = 0;
    if (halt_cpu == 0 && tick_cpu == 0) {
     /* Serial.print("Executing: ");
      Serial.print(MEMORY[PC], HEX);
      Serial.print(", arg1: ");
      Serial.print(MEMORY[PC + 1]);
      Serial.print(", Y position: ");
      Serial.print(p_Y);
      Serial.print(", X: ");
      Serial.print(X);
      Serial.print(", VSYNC: ");
      Serial.print(MEMORY[0x00]);*/
      tick_cpu = execute(MEMORY[PC], MEMORY[PC + 1], MEMORY[PC + 2]);
      PC = PC & 0b0001111111111111;
      //Serial.println();
    }
    else {
      tick_cpu -- ;
      //Serial.println("NOCPU");
    }
  }
  tia();
}
